## board/zerocore/fboard/Kconfig
```kconfig
if TARGET_ZEROCORE_FBOARD

config SYS_CPU
    default "generic"

config SYS_BOARD
	default "fboard"

config SYS_VENDOR
	default "zerocore"

config SYS_CONFIG_NAME
	default "fboard"

endif
```

## configs/Zerocore_defconfig
```kconfig
CONFIG_RISCV=y
CONFIG_TEXT_BASE=0x80400000
CONFIG_SYS_MALLOC_LEN=0x800000
CONFIG_NR_DRAM_BANKS=1
CONFIG_HAS_CUSTOM_SYS_INIT_SP_ADDR=y
CONFIG_CUSTOM_SYS_INIT_SP_ADDR=0x80200000
CONFIG_ENV_SIZE=0x20000
CONFIG_DEFAULT_DEVICE_TREE="zerocore_dual"
CONFIG_SYS_MONITOR_LEN=786432
CONFIG_PRE_CON_BUF_ADDR=0x81000000
CONFIG_SYS_LOAD_ADDR=0x80200000
CONFIG_PCI=y
CONFIG_AHCI=y
CONFIG_TARGET_ZEROCORE_FBOARD=y
CONFIG_RISCV_SMODE=y
# CONFIG_RISCV_ISA_C is not set
# CONFIG_RISCV_ISA_F is not set
CONFIG_LOCALVERSION="zerocore uboot"
CONFIG_FIT=y
CONFIG_DISTRO_DEFAULTS=y
CONFIG_BOOTDELAY=5
CONFIG_USE_BOOTARGS=y
CONFIG_BOOTARGS="earlycon=sbi console=ttyUL0"
CONFIG_BOOTCOMMAND="load mmc 0:2 90000000 uImage;setenv bootargs 'earlycon=sbi console=ttyUL0,9600 init=/linuxrc'; bootm 90000000 - $fdtcontroladdr"
CONFIG_PRE_CONSOLE_BUFFER=y
CONFIG_DISPLAY_CPUINFO=y
CONFIG_DISPLAY_BOARDINFO=y
CONFIG_BOARD_LATE_INIT=y
CONFIG_PCI_INIT_R=y
CONFIG_SYS_CBSIZE=256
CONFIG_SYS_PBSIZE=276
CONFIG_CMD_CPU=y
CONFIG_CMD_SBI=y
CONFIG_SYS_BOOTM_LEN=0x4000000
CONFIG_CMD_BOOTEFI_SELFTEST=y
CONFIG_CMD_NVEDIT_EFI=y
CONFIG_CMD_MMC=y
CONFIG_CMD_BKOPS_ENABLE=y
CONFIG_CMD_MMC_SWRITE=y
CONFIG_CMD_MTD=y
CONFIG_CMD_PCI=y
CONFIG_CMD_POWEROFF=y
CONFIG_CMD_USB=y
CONFIG_CMD_2048=y
CONFIG_PARTITION_TYPE_GUID=y
CONFIG_OF_BOARD=y
CONFIG_OF_OMIT_DTB=y
CONFIG_SYS_RELOC_GD_ENV_ADDR=y
# CONFIG_NET is not set
CONFIG_SCSI_AHCI=y
CONFIG_AHCI_PCI=y
CONFIG_CPU=y
CONFIG_CPU_RISCV=y
CONFIG_MMC=y
CONFIG_MMC_SPI=y
CONFIG_DM_MTD=y
CONFIG_FLASH_SHOW_PROGRESS=0
CONFIG_CFI_FLASH=y
CONFIG_SYS_MAX_FLASH_BANKS=2
CONFIG_MTD_SPI_NAND=y
CONFIG_SPI_FLASH_ATMEL=y
CONFIG_SPI_FLASH_EON=y
CONFIG_SPI_FLASH_GIGADEVICE=y
CONFIG_SPI_FLASH_ISSI=y
CONFIG_SPI_FLASH_MACRONIX=y
CONFIG_SPI_FLASH_SPANSION=y
CONFIG_SPI_FLASH_STMICRO=y
CONFIG_SPI_FLASH_SST=y
CONFIG_SPI_FLASH_WINBOND=y
CONFIG_SPI_FLASH_XMC=y
CONFIG_SPI_FLASH_XTX=y
CONFIG_SPI_FLASH_DATAFLASH=y
CONFIG_SPI_FLASH_MTD=y
CONFIG_NVME=y
CONFIG_PCIE_ECAM_GENERIC=y
CONFIG_DM_RNG=y
CONFIG_SCSI=y
CONFIG_DM_SCSI=y
CONFIG_SYS_NS16550=y
CONFIG_XILINX_UARTLITE=y
CONFIG_SIFIVE_SERIAL=y
CONFIG_SPI=y
CONFIG_XILINX_SPI=y
CONFIG_SYSRESET=y
CONFIG_SYSRESET_SYSCON=y
CONFIG_RISCV_TIMER=y
CONFIG_XILINX_TIMER=y
CONFIG_USB=y
CONFIG_USB_XHCI_HCD=y
CONFIG_USB_XHCI_PCI=y
CONFIG_USB_KEYBOARD=y
CONFIG_VIDEO=y
CONFIG_SYS_WHITE_ON_BLACK=y
CONFIG_VIDEO_BOCHS=y
CONFIG_VIRTIO_MMIO=y
CONFIG_VIRTIO_PCI=y
CONFIG_VIRTIO_NET=y
CONFIG_VIRTIO_BLK=y
```
